#include "esp_http_server.h"
#include "esp_camera.h"
#include <WiFi.h>
#include "Arduino.h"

const char* ssid = "NSA";
const char* password = "orange";

//Select a sensible image size for image to avoid overloading camera/wifi etc
//#define TIMELAPSE_FRAMESIZE FRAMESIZE_QQVGA    // 160x120
//#define TIMELAPSE_FRAMESIZE FRAMESIZE_QQVGA2   // 128x160
//#define TIMELAPSE_FRAMESIZE FRAMESIZE_QCIF     // 176x144
//#define TIMELAPSE_FRAMESIZE FRAMESIZE_HQVGA    // 240x176
//#define TIMELAPSE_FRAMESIZE FRAMESIZE_QVGA     // 320x240
//#define TIMELAPSE_FRAMESIZE FRAMESIZE_CIF      // 400x296
//#define TIMELAPSE_FRAMESIZE FRAMESIZE_VGA      // 640x480
//#define TIMELAPSE_FRAMESIZE FRAMESIZE_SVGA     // 800x600
#define TIMELAPSE_FRAMESIZE FRAMESIZE_XGA        // 1024x768
//#define TIMELAPSE_FRAMESIZE FRAMESIZE_SXGA     // 1280x1024
//#define TIMELAPSE_FRAMESIZE FRAMESIZE_UXGA     // 1600x1200
//#define TIMELAPSE_FRAMESIZE FRAMESIZE_QXGA     // 2048*1536


#define index_html_gz_len 3663
// view source in browser to see HTML. See Editing ESP32 HTML tutorial for how to edit.
const uint8_t index_html_gz[] = {
0x1f,0x8b,0x08,0x00,0x97,0xa1,0xb9,0x5c,0x00,0xff,0x7d,0x54,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0x00
};

httpd_handle_t camera_httpd = NULL;

char filename[40];
int file_number = 0;

 // CAMERA_MODEL_AI_THINKER
#define PWDN_GPIO_NUM     32
#define RESET_GPIO_NUM    -1
#define XCLK_GPIO_NUM      0
#define SIOD_GPIO_NUM     26
#define SIOC_GPIO_NUM     27

#define Y9_GPIO_NUM       35
#define Y8_GPIO_NUM       34
#define Y7_GPIO_NUM       39
#define Y6_GPIO_NUM       36
#define Y5_GPIO_NUM       21
#define Y4_GPIO_NUM       19
#define Y3_GPIO_NUM       18
#define Y2_GPIO_NUM        5
#define VSYNC_GPIO_NUM    25
#define HREF_GPIO_NUM     23
#define PCLK_GPIO_NUM     22

void startCameraServer();

void setup() {
  Serial.begin(115200);
  Serial.setDebugOutput(true);
  Serial.println();

  camera_config_t config;
  config.ledc_channel = LEDC_CHANNEL_0;
  config.ledc_timer = LEDC_TIMER_0;
  config.pin_d0 = Y2_GPIO_NUM;
  config.pin_d1 = Y3_GPIO_NUM;
  config.pin_d2 = Y4_GPIO_NUM;
  config.pin_d3 = Y5_GPIO_NUM;
  config.pin_d4 = Y6_GPIO_NUM;
  config.pin_d5 = Y7_GPIO_NUM;
  config.pin_d6 = Y8_GPIO_NUM;
  config.pin_d7 = Y9_GPIO_NUM;
  config.pin_xclk = XCLK_GPIO_NUM;
  config.pin_pclk = PCLK_GPIO_NUM;
  config.pin_vsync = VSYNC_GPIO_NUM;
  config.pin_href = HREF_GPIO_NUM;
  config.pin_sscb_sda = SIOD_GPIO_NUM;
  config.pin_sscb_scl = SIOC_GPIO_NUM;
  config.pin_pwdn = PWDN_GPIO_NUM;
  config.pin_reset = RESET_GPIO_NUM;
  config.xclk_freq_hz = 20000000;
  config.pixel_format = PIXFORMAT_JPEG;
  //init with high specs to pre-allocate larger buffers
  if (psramFound()) {
    config.frame_size = FRAMESIZE_UXGA;
    config.jpeg_quality = 10;
    config.fb_count = 2;
  } else {
    config.frame_size = FRAMESIZE_SVGA;
    config.jpeg_quality = 12;
    config.fb_count = 1;
  }
   
  // camera init
  esp_err_t err = esp_camera_init(&config);
  if (err != ESP_OK) {
    Serial.printf("Camera init failed with error 0x%x", err);
    return;
  }

 //drop down frame size for shorter interval capture
  sensor_t * s = esp_camera_sensor_get();
  s->set_framesize(s, TIMELAPSE_FRAMESIZE);

  WiFi.begin(ssid, password);
  while (WiFi.status() != WL_CONNECTED) {
    delay(500);
    Serial.print(".");
  }
  Serial.println("");
  Serial.println("WiFi connected");

  startCameraServer();

  Serial.print("Camera Ready! Use 'http://");
  Serial.print(WiFi.localIP());
  Serial.println("' to connect");
}

static esp_err_t capture_handler(httpd_req_t *req) {

  camera_fb_t * fb = NULL;
  esp_err_t res = ESP_OK;

  fb = esp_camera_fb_get();
  if (!fb) {
    Serial.println("Camera capture failed");
    httpd_resp_send_500(req);
    return ESP_FAIL;
  }
  
  file_number++;
  sprintf(filename, "inline; filename=capture_%d.jpg", file_number);
  
  httpd_resp_set_type(req, "image/jpeg");
  httpd_resp_set_hdr(req, "Content-Disposition", filename);

  size_t out_len, out_width, out_height;
  size_t fb_len = 0;
  fb_len = fb->len;
  res = httpd_resp_send(req, (const char *)fb->buf, fb->len);
  esp_camera_fb_return(fb);

  return res;
}

static esp_err_t index_handler(httpd_req_t *req) {
  httpd_resp_set_type(req, "text/html");
  httpd_resp_set_hdr(req, "Content-Encoding", "gzip");
  return httpd_resp_send(req, (const char *)index_html_gz, index_html_gz_len);
}

void startCameraServer() {
  httpd_config_t config = HTTPD_DEFAULT_CONFIG();

  httpd_uri_t index_uri = {
    .uri       = "/",
    .method    = HTTP_GET,
    .handler   = index_handler,
    .user_ctx  = NULL
  };
  httpd_uri_t capture_uri = {
    .uri       = "/capture",
    .method    = HTTP_GET,
    .handler   = capture_handler,
    .user_ctx  = NULL
  };

  if (httpd_start(&camera_httpd, &config) == ESP_OK) {
    httpd_register_uri_handler(camera_httpd, &index_uri);
    httpd_register_uri_handler(camera_httpd, &capture_uri);
  }
}

void loop() {
  // loop not used
  delay(10000);
}
